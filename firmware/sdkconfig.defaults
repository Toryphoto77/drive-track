## firmware/sdkconfig.defaults
```kconfig
# DriveTrack 自研硬件固件默认配置（ESP-IDF v5.1 ~ v5.4，目标芯片 esp32s3）
# 首次执行 idf.py set-target esp32s3 时生效；改完请删除 sdkconfig 后重新 build。

# Flash：WROOM-1U-N16R8 = 16 MB
CONFIG_ESPTOOLPY_FLASHSIZE_16MB=y
CONFIG_PARTITION_TABLE_CUSTOM=y
CONFIG_PARTITION_TABLE_CUSTOM_FILENAME="partitions.csv"

# OTA：新固件首次启动若未确认，自动回滚到旧分区
CONFIG_BOOTLOADER_APP_ROLLBACK_ENABLE=y

# 蓝牙（NimBLE，体积小于 Bluedroid）
CONFIG_BT_ENABLED=y
CONFIG_BT_NIMBLE_ENABLED=y
CONFIG_BT_NIMBLE_MAX_CONNECTIONS=1
CONFIG_BT_NIMBLE_ATT_PREFERRED_MTU=247
CONFIG_BT_NIMBLE_HOST_TASK_STACK_SIZE=5120
CONFIG_BT_NIMBLE_NVS_PERSIST=y

# WiFi 与蓝牙共存
CONFIG_ESP_COEX_SW_COEXIST_ENABLE=y

# HTTP 服务：OTA 上传缓冲与长连接超时
CONFIG_HTTPD_MAX_REQ_HDR_LEN=1024
CONFIG_HTTPD_MAX_URI_LEN=512

# 任务与日志
CONFIG_FREERTOS_HZ=1000
CONFIG_ESP_MAIN_TASK_STACK_SIZE=6144
CONFIG_LOG_DEFAULT_LEVEL_INFO=y

# 8 MB 八线 PSRAM（N16R8 自带）。本固件不主动使用，开启只为必要时可调度。
CONFIG_SPIRAM=y
CONFIG_SPIRAM_MODE_OCT=y
CONFIG_SPIRAM_SPEED_80M=y
```
